## firmware/mars_system/components/mars_emote_gfx/Kconfig
```kconfig
menu "Mars app EAF renderer"

    config GFX_EAF_JPEG_DECODE_SUPPORT
        bool "Enable JPEG decoding in EAF resources"
        default y

    config GFX_EAF_HEATSHRINK_SUPPORT
        bool "Enable Heatshrink decoding in EAF resources"
        default y
        depends on HEATSHRINK_DYNAMIC_ALLOC || (HEATSHRINK_STATIC_WINDOW_BITS = 8 && HEATSHRINK_STATIC_LOOKAHEAD_BITS = 4)

endmenu
```

## firmware/mars_system/main/Kconfig.projbuild
```kconfig
menu "Mars system"

config MARS_LAYOUT_V2
    bool "Use the 16 MiB v2 system/app/assets layout"
    default y
    help
        Embed the shared Chinese font in the system image and load the single
        desktop wallpaper from the mmap assets partition. The uidata SPIFFS
        partition then stores only user UI data and settings.

endmenu
```
